## conf/layer.conf
```bitbake
# We have a conf directory, append to BBPATH
BBPATH := "${BBPATH}:${LAYERDIR}"

# We have a recipes directory, add to BBFILES
BBFILES := "${BBFILES} ${LAYERDIR}/recipes-*/*/*.bb \
	${LAYERDIR}/recipes-*/*/*.bbappend"

BBFILE_COLLECTIONS += "ada"
BBFILE_PATTERN_ada := "^${LAYERDIR}/"
BBFILE_PRIORITY_ada = "6"

GPR_PROJECT_PATH = "."
```
